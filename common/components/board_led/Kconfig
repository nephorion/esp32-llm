## common/components/board_led/Kconfig
```kconfig
menu "Board LED"
    config LED_GPIO
        int "GPIO number of the on-board LED"
        default 48
        help
            The pin the LED is wired to. Most ESP32-S3 dev boards put an addressable RGB LED
            on GPIO48 (older revisions use GPIO38). Check your board's silkscreen or schematic.

    config LED_IS_RGB
        bool "The LED is an addressable RGB (WS2812) LED"
        default y
        help
            Say yes for the colour "NeoPixel" style LED found on most dev boards (driven
            with a special one-wire signal). Say no for a plain LED that is simply
            switched on and off by the pin.
endmenu
```

## main/Kconfig.projbuild
```kconfig
menu "LED"
    config LED_GPIO
        int "LED GPIO"
        default 48
    config LED_IS_RGB
        bool "LED is an addressable RGB (WS2812) LED"
        default y
endmenu
```

## projects/bench/sdkconfig.defaults
```kconfig
CONFIG_SPIRAM=y
CONFIG_SPIRAM_MODE_OCT=y
CONFIG_SPIRAM_SPEED_40M=y
CONFIG_COMPILER_OPTIMIZATION_PERF=y
CONFIG_ESP_TASK_WDT_EN=n
```
